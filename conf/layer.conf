## conf/layer.conf
```bitbake
# We have a conf and classes directory, add to BBPATH
BBPATH .= ":${LAYERDIR}"

# We have recipes-* directories, add to BBFILES
BBFILES += "${LAYERDIR}/recipes-*/*/*.bb \
            ${LAYERDIR}/recipes-*/*/*.bbappend"

BBFILE_COLLECTIONS += "meta-evb-ksz9477"
BBFILE_PATTERN_meta-evb-ksz9477 = "^${LAYERDIR}/"
BBFILE_PRIORITY_meta-evb-ksz9477 = "6"

LAYERDEPENDS_meta-evb-ksz9477 = "core"
LAYERSERIES_COMPAT_meta-evb-ksz9477 = "kirkstone"
```

## conf/machine/sama5d3-eds-sd.conf
```bitbake
#@TYPE: Machine
#@Name: ATMEL SAMA5D3 EDS KSZ9477 SD
#@DESCRIPTION: Machine configuration for Microchip EVB-KSZ9477 evaluation board

require conf/machine/include/sama5d3.inc

MACHINE_FEATURES = "apm alsa ext2 ext3 usbhost usbgadget screen touchscreen wifi"
KERNEL_DEVICETREE = " \
		at91-sama5d3_eds.dtb \
		"
IMAGE_FSTYPES += " tar.gz wic"

do_image_wic[depends] += "u-boot-mchp:do_deploy"
WKS_FILE = "sdimage-bootpart.wks"
IMAGE_BOOT_FILES = "BOOT.BIN u-boot.bin uboot.env sama5d3_eds.itb"

# used by sysvinit_2
SERIAL_CONSOLES ?= "115200;ttyS0 115200;ttyGS0"

UBOOT_MACHINE ?= "sama5d3_xplained_mmc_defconfig"
UBOOT_ENTRYPOINT = "0x20008000"
UBOOT_LOADADDRESS = "0x20008000"
UBOOT_ENV_SIZE = "0x4000"

AT91BOOTSTRAP_MACHINE ?= "sama5d3_eds"

# Needed for FIT
MACHINE_ESSENTIAL_EXTRA_RDEPENDS = " dt-overlay-mchp"
```
